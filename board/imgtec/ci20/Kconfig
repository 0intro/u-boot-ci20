## board/imgtec/ci20/Kconfig
```kconfig
if TARGET_CI20

config SYS_CPU
	default "xburst"

config SYS_BOARD
	default "ci20"

config SYS_VENDOR
	default "imgtec"

config SYS_SOC
	default "jz4780"

config SYS_CONFIG_NAME
	default "ci20"

endif
```

## configs/ci20mmc_defconfig
```kconfig
CONFIG_MIPS=y
CONFIG_TARGET_CI20=y
CONFIG_SPL=y
# CONFIG_CMD_IMLS is not set
CONFIG_SYS_EXTRA_OPTIONS="ENV_IS_IN_MMC"
CONFIG_CMD_NAND=y
```
